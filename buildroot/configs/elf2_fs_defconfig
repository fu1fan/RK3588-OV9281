## buildroot/configs/elf2_fs_defconfig
```kconfig
#include "base/base.config"
#include "chips/rk3588_aarch64.config"
#include "font/chinese.config"
#include "fs/exfat.config"
#include "fs/ntfs.config"
#include "fs/vfat.config"
#include "gpu/gpu.config"
#include "multimedia/audio.config"
#include "multimedia/camera.config"
#include "multimedia/gst/audio.config"
#include "multimedia/gst/camera.config"
#include "multimedia/gst/rtsp.config"
#include "multimedia/gst/video.config"
#include "multimedia/mpp.config"
#include "wifibt/bt.config"
#include "wifibt/wireless.config"
#include "tools/benchmark.config"
#include "tools/common.config"
#include "tools/test.config"
#include "network/chromium.config"
#include "npu2.config"
#include "powermanager.config"
#include "weston.config"
#include "qt.config"
#include "qtwebengine.config"

BR2_ROOTFS_OVERLAY+="board/rockchip/common/base board/elfboard/elf2/fs-overlay/"
BR2_TARGET_GENERIC_HOSTNAME="elf2"
BR2_TARGET_GENERIC_ISSUE="Welcome to ELF 2 Board"
BR2_TARGET_ENABLE_ROOT_LOGIN=y
BR2_TARGET_GENERIC_ROOT_PASSWD="root"
BR2_TARGET_LOCALTIME="Asia/Shanghai"

BR2_PACKAGE_CAN_UTILS=y
BR2_PACKAGE_IPTABLES=y
BR2_PACKAGE_IPERF3=y
BR2_PACKAGE_ETHTOOL=y
BR2_PACKAGE_IPROUTE2=y
BR2_PACKAGE_VSFTPD=y

BR2_PACKAGE_PHP=y
BR2_PACKAGE_PHP_SAPI_CGI=y
BR2_PACKAGE_PHP_SAPI_CLI=y
BR2_PACKAGE_PHP_EXT_FILEINFO=y
BR2_PACKAGE_PHP_EXT_OPCACHE=y
BR2_PACKAGE_PHP_EXT_READLINE=y
BR2_PACKAGE_PHP_EXT_ICONV=y
BR2_PACKAGE_PHP_EXT_MBSTRING=y
BR2_PACKAGE_PHP_EXT_JSON=y
BR2_PACKAGE_PHP_EXT_TOKENIZER=y
BR2_PACKAGE_PHP_EXT_CURL=y
BR2_PACKAGE_PHP_EXT_FTP=y
BR2_PACKAGE_PHP_EXT_SOAP=y
BR2_PACKAGE_LIGHTTPD=y
BR2_PACKAGE_LIGHTTPD_PCRE=y
BR2_PACKAGE_VIM=y
BR2_PACKAGE_DHCPCD=n
BR2_PACKAGE_DNSMASQ=y
BR2_PACKAGE_CRDA=y
BR2_PACKAGE_OPENSSL=y
BR2_PACKAGE_ZLIB=y
BR2_PACKAGE_OPENSSH=y
BR2_PACKAGE_OPENSSH_GEN_KEYS=y

BR2_PACKAGE_ELF=y
BR2_PACKAGE_ELF_CMD=y
BR2_PACKAGE_ELF_QT=y

BR2_PACKAGE_FILE=y
BR2_PACKAGE_QUECTELCM=y
BR2_PACKAGE_UBOOT_TOOLS=y
```

## buildroot/package/elf/Config.in
```kconfig
menuconfig BR2_PACKAGE_ELF
	bool "ELF BSP packages"

if BR2_PACKAGE_ELF

source "package/elf/quectelCM/Config.in"
source "package/elf/elf_cmd/Config.in"
source "package/elf/elf_qt/Config.in"

endif
```

## buildroot/package/elf/elf_cmd/Config.in
```kconfig
config BR2_PACKAGE_ELF_CMD
	bool "elf_cmd_demo"
	help
	  ELF elf_cmd_demo application based
```

## buildroot/package/elf/elf_qt/Config.in
```kconfig
config BR2_PACKAGE_ELF_QT
	bool "elf_qt_demo"
	depends on BR2_PACKAGE_QT5
	depends on BR2_PACKAGE_QT5SERIALBUS
	depends on BR2_PACKAGE_QT5MULTIMEDIA
	depends on BR2_PACKAGE_QT5WEBENGINE
	depends on BR2_PACKAGE_QT5WAYLAND
	help
	  ELF elf_qt_demo application based on QT
```

## u-boot/arch/arm/mach-rockchip/rk3588/Kconfig
```kconfig
if ROCKCHIP_RK3588

config TARGET_EVB_RK3588
	bool "EVB_RK3588"
	select BOARD_LATE_INIT
	help
	  RK3588 EVB is a evaluation board for Rockchp RK3588.

config TARGET_ELF2_KCONFIG
	bool "ELF2_KCONFIG"
	select BOARD_LATE_INIT
	help
		Support ELF2 board.

config SYS_SOC
	default "rockchip"

config SYS_MALLOC_F_LEN
	default 0x400

source board/rockchip/evb_rk3588/Kconfig
source board/rockchip/elf2/Kconfig
endif
```

## u-boot/board/rockchip/elf2/Kconfig
```kconfig
if TARGET_ELF2_KCONFIG

config SYS_BOARD
	default "elf2"

config SYS_VENDOR
	default "rockchip"

config SYS_CONFIG_NAME
	default "elf2"

config BOARD_SPECIFIC_OPTIONS # dummy
	def_bool y

endif
```
